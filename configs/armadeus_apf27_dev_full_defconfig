## configs/armadeus_apf27_dev_full_defconfig
```kconfig
# architecture
BR2_arm=y
BR2_arm926t=y

# patches
BR2_GLOBAL_PATCH_DIR="$(BR2_EXTERNAL_ARMADEUS_PATH)/board/armadeus/apf27/patches"

# system
BR2_TARGET_GENERIC_GETTY_PORT="ttymxc0"

# filesystem
BR2_TARGET_ROOTFS_UBIFS=y
BR2_TARGET_ROOTFS_UBIFS_MAXLEBCNT=2047
BR2_TARGET_ROOTFS_UBI=y

# bootloader
BR2_TARGET_UBOOT=y
BR2_TARGET_UBOOT_BUILD_SYSTEM_KCONFIG=y
BR2_TARGET_UBOOT_USE_DEFCONFIG=y
BR2_TARGET_UBOOT_BOARD_DEFCONFIG="apf27"
BR2_TARGET_UBOOT_FORMAT_CUSTOM=y
BR2_TARGET_UBOOT_FORMAT_CUSTOM_NAME="u-boot-with-nohab-spl.bin"
BR2_TARGET_UBOOT_ENVIMAGE=y
BR2_TARGET_UBOOT_ENVIMAGE_SOURCE="$(BR2_EXTERNAL_ARMADUES_PATH)/board/armadeus/apf27/uboot-env.txt"
BR2_TARGET_UBOOT_ENVIMAGE_SIZE="0x80000"
BR2_TARGET_UBOOT_ENVIMAGE_REDUNDANT=y
BR2_TARGET_UBOOT_CUSTOM_DTS_PATH="$(BR2_EXTERNAL_ARMADEUS_PATH)/board/armadeus/apf27/dts/imx27-apf27.dtsi $(BR2_EXTERNAL_ARMADEUS_PATH)/board/armadeus/apf27/dts/imx27-apf27_dev_full.dts"
```
